## conf/machine/formuler1.conf
```bitbake
#@TYPE: Machine
#@NAME: formuler f1
#@DESCRIPTION: Machine configuration for the formuler f1

MACHINE_FEATURES += "dvb-c"

CHIPSET = "bcm7356"

require conf/machine/include/formuler.inc
```

## conf/machine/formuler3.conf
```bitbake
#@TYPE: Machine
#@NAME: formuler f3
#@DESCRIPTION: Machine configuration for the formuler f3

MACHINE_FEATURES += "7segment"

CHIPSET = "bcm7362"

require conf/machine/include/formuler.inc
```

## conf/machine/formuler4.conf
```bitbake
#@TYPE: Machine
#@NAME: formuler f4
#@DESCRIPTION: Machine configuration for the formuler f4

MACHINE_FEATURES += "7seg"

CHIPSET = "bcm7362"

require conf/machine/include/formuler.inc
```

## conf/machine/formuler4turbo.conf
```bitbake
#@TYPE: Machine
#@NAME: formuler f4turbo
#@DESCRIPTION: Machine configuration for the formuler f4turbo

MACHINE_FEATURES += "7seg dvb-c"

DVBMEDIASINK_CONFIG_append = " --with-h265 --with-vb6 --with-vb8 --with-spark"

CHIPSET = "bcm73625"

require conf/machine/include/formuler.inc
```
